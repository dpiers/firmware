## experimental/nt98513/configs/nt98513_shared_clock_defconfig
```kconfig
BR2_mipsel=y
BR2_mips_32r2=y
BR2_MIPS_SOFT_FLOAT=y
BR2_TOOLCHAIN_BUILDROOT=y
BR2_TOOLCHAIN_BUILDROOT_VENDOR="openipc"
BR2_TOOLCHAIN_BUILDROOT_MUSL=y
BR2_GCC_VERSION_12_X=y
BR2_BINUTILS_VERSION_2_41_X=y
BR2_KERNEL_HEADERS_AS_KERNEL=y
BR2_PACKAGE_HOST_LINUX_HEADERS_CUSTOM_6_6=y
BR2_STATIC_LIBS=y
BR2_OPTIMIZE_S=y
BR2_REPRODUCIBLE=y
BR2_CCACHE=n
BR2_DL_DIR="/work/dl"
BR2_INIT_BUSYBOX=y
BR2_ROOTFS_DEVICE_CREATION_STATIC=y
BR2_ROOTFS_DEVICE_TABLE=""
BR2_ROOTFS_STATIC_DEVICE_TABLE="$(BR2_EXTERNAL_NT98513_PATH)/board/devices.txt"
BR2_ROOTFS_SKELETON_CUSTOM=y
BR2_ROOTFS_SKELETON_CUSTOM_PATH="$(BR2_EXTERNAL_NT98513_PATH)/board/rootfs"
BR2_TARGET_GENERIC_HOSTNAME="openipc-nt98513-ram"
BR2_TARGET_GENERIC_ISSUE="Experimental OpenIPC NT98513 RAM console"
# BR2_TARGET_GENERIC_GETTY is not set
BR2_PACKAGE_BUSYBOX=y
BR2_PACKAGE_BUSYBOX_CONFIG="$(BR2_EXTERNAL_NT98513_PATH)/board/busybox.config"
BR2_LINUX_KERNEL=y
BR2_LINUX_KERNEL_CUSTOM_TARBALL=y
BR2_LINUX_KERNEL_CUSTOM_TARBALL_LOCATION="file:///inputs/linux-6.6.158.tar.xz"
BR2_GLOBAL_PATCH_DIR="$(BR2_EXTERNAL_NT98513_PATH)/patches"
BR2_LINUX_KERNEL_USE_CUSTOM_CONFIG=y
BR2_LINUX_KERNEL_CUSTOM_CONFIG_FILE="$(BR2_EXTERNAL_NT98513_PATH)/board/linux.config"
BR2_LINUX_KERNEL_VMLINUX_BIN=y
BR2_TARGET_ROOTFS_CPIO=y
BR2_TARGET_ROOTFS_CPIO_FULL=y
BR2_TARGET_ROOTFS_INITRAMFS=y
# BR2_TARGET_ROOTFS_TAR is not set
BR2_JLEVEL=4
BR2_WGET="wget --passive-ftp -nd -t 2 -T 20"
BR2_BACKUP_SITE="https://sources.buildroot.net"

BR2_ROOTFS_OVERLAY="$(BR2_EXTERNAL_NT98513_PATH)/board/overlay"

BR2_TAR_OPTIONS="--no-same-owner"

# BR2_PACKAGE_URANDOM_SCRIPTS is not set

BR2_ROOTFS_POST_BUILD_SCRIPT="$(BR2_EXTERNAL_NT98513_PATH)/board/normalize-rootfs.py"

# Experimental complete shared-clock board; no consumer or auto-service.
BR2_LINUX_KERNEL_CONFIG_FRAGMENT_FILES="$(BR2_EXTERNAL_NT98513_PATH)/board/shared-clock.config"
```

## experimental/nt98513/package/divinus-owned-nt98513/Config.in
```kconfig
config BR2_PACKAGE_DIVINUS_OWNED_NT98513
	bool "Divinus NT98513 owned encoded input"
	depends on BR2_mipsel && BR2_mips_32r2
	depends on BR2_TOOLCHAIN_HAS_THREADS
	depends on BR2_STATIC_LIBS
	help
	  Optional RTSP consumer of /dev/nt98513-capture. Requires a separately
	  admitted capture endpoint and external keeper. No automatic startup.

	  Source: https://github.com/dpiers/divinus (pinned owner experiment).
	  Prepare the exact source archive offline as described in the
	  experimental/nt98513 README; no network fetch occurs at runtime.
```

## experimental/nt98513/package/nt98513-wifi-control/Config.in
```kconfig
config BR2_PACKAGE_NT98513_WIFI_CONTROL
	bool "NT98513 manual Wi-Fi station supervisor"
	depends on BR2_STATIC_LIBS
	depends on BR2_TOOLCHAIN_HAS_THREADS
	depends on BR2_USE_MMU
	depends on !BR2_PACKAGE_WPA_SUPPLICANT
	select BR2_PACKAGE_WPA_SUPPLICANT_NT98513
	select BR2_PACKAGE_BUSYBOX
	help
	  Explicit owner-started WPA2 station and IPv4 DHCP lifecycle.
	  No boot service or credentials are installed. Requires rtl8xxxu,
	  udhcpc, safe root-owned input and exclusive resolver ownership.
```

## experimental/nt98513/package/rtl8188fu-firmware-nt98513/Config.in
```kconfig
config BR2_PACKAGE_RTL8188FU_FIRMWARE_NT98513
	bool "NT98513 RTL8188FU firmware subset"
	help
	  Install only the licensed rtlwifi/rtl8188fufw.bin from pinned
	  linux-firmware 20240115, with its license and WHENCE notices.
```

## experimental/nt98513/package/wpa-supplicant-nt98513/Config.in
```kconfig
config BR2_PACKAGE_WPA_SUPPLICANT_NT98513
	bool "NT98513 isolated WPA2 supplicant"
	depends on BR2_STATIC_LIBS
	depends on BR2_TOOLCHAIN_HAS_THREADS
	depends on BR2_USE_MMU
	depends on !BR2_PACKAGE_WPA_SUPPLICANT
	select BR2_PACKAGE_LIBNL
	help
	  Pinned wpa_supplicant 2.12 for the explicit NT98513 station image.
	  Static nl80211/internal crypto, private control interface and CLI.
	  No network configuration or startup service is installed.
```
